/* Формат выходного файла - 32-битный (i386) */
OUTPUT_FORMAT(elf32-i386)

/* 
 * Точка входа программы - символ 'start' 
 * Это первая инструкция, которая будет выполнена при загрузке программы
 */
ENTRY(start)

SECTIONS
{
    /* 
     * Устанавливаем текущий адрес размещения на 1MB (0x100000)
     */
    . = 0x100000;
    
    /* Символ начала ядра */
    _kernel_start = .;
    
    .text : { *(.text) *(.text.*) }
    .rodata : { *(.rodata) *(.rodata.*) }

    .data : { *(.data) *(.data.*) }

    /*
     * Таблица экспортируемых символов ядра (EXPORT_SYMBOL).
     * Собирается в один непрерывный массив между двумя символами,
     * по которому загрузчик модулей разрешает внешние ссылки.
     */
    .ksymtab : {
        . = ALIGN(4);
        __ksymtab_start = .;
        KEEP(*(.ksymtab))
        __ksymtab_end = .;
    }

    /*
     * Образы встроенных .ko (сырые байты, добавленные objcopy).
     */
    .kmod : {
        . = ALIGN(16);
        *(.kmod)
    }

    .bss  : { *(.bss) *(.bss.*) *(COMMON) }
    
    /* Символ конца ядра */
    _kernel_end = .;
}
